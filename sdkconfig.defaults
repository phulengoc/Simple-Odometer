## sdkconfig.defaults
```kconfig
# ESP-IDF project minimal configuration — ESP32-S3 QSPI AMOLED display template.
#
CONFIG_IDF_TARGET="esp32s3"

# Flash: 8 MB, QIO
CONFIG_ESPTOOLPY_FLASHMODE_QIO=y
CONFIG_ESPTOOLPY_FLASHSIZE_8MB=y

# Custom partition table (see partitions.csv)
CONFIG_PARTITION_TABLE_CUSTOM=y

# Performance: 240 MHz CPU, -O2
CONFIG_COMPILER_OPTIMIZATION_PERF=y
CONFIG_ESP_DEFAULT_CPU_FREQ_MHZ_240=y
CONFIG_ESP32S3_DATA_CACHE_LINE_64B=y
CONFIG_FREERTOS_HZ=1000

# Octal PSRAM @ 80 MHz — the full-screen RGB565 framebuffer (~434 KB) is
# allocated here (see status_screen.cpp).
CONFIG_SPIRAM=y
CONFIG_SPIRAM_MODE_OCT=y
CONFIG_SPIRAM_SPEED_80M=y
```
