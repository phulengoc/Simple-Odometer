#include "status_screen.h"

#include <string.h>
#include "esp_heap_caps.h"
#include "esp_log.h"
#include "freertos/task.h"

static const char *TAG = "status_screen";

// ── Panel geometry ────────────────────────────────────────────────────────────
#define SCR_W   466
#define SCR_H   466
#define STRIP_H 16          // rows per DMA blit (internal-RAM staging buffer)

// ── Colours (native RGB565). Written byte-swapped to match the panel's
//    big-endian byte order — the JPEG path uses RGB565_BIG_ENDIAN, so we must too.
#define COL_BG     0x0000   // black
#define COL_TITLE  0xFFFF   // white
#define COL_STATUS 0xFD20   // amber
#define COL_INFO   0xAD55   // light grey

// ── Font layout ─────────────────────────────────────────────────────────────
#define GLYPH_W     8
#define GLYPH_H     8
#define TITLE_SCALE 4       // line 1: 32 px tall
#define BODY_SCALE  3       // lines 2-4: 24 px tall
#define LINE_GAP    14

static esp_lcd_panel_handle_t s_panel  = NULL;
static SemaphoreHandle_t      s_dma_sem = NULL;

static inline uint16_t be565(uint16_t c) { return (uint16_t)((c >> 8) | (c << 8)); }

// 8×8 bitmap font (public-domain font8x8_basic, Daniel Hepper), printable ASCII
// 0x20–0x7E. Each byte is one row; bit 0 (LSB) is the leftmost column.
static const uint8_t FONT8X8[95][8] = {
    {0x00,0x00,0x00,0x00,0x00,0x00,0x00,0x00}, // ' '
    {0x18,0x3C,0x3C,0x18,0x18,0x00,0x18,0x00}, // '!'
    {0x36,0x36,0x00,0x00,0x00,0x00,0x00,0x00}, // '"'
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    {0x6E,0x3B,0x00,0x00,0x00,0x00,0x00,0x00}, // '~'
};

// Blit one scaled glyph into a `canvas_w × canvas_h` RGB565 canvas at (x0, y0).
static void draw_glyph(uint16_t *canvas, int canvas_w, int canvas_h,
                       int x0, int y0, char ch, int scale, uint16_t color_be)
{
    if (ch < 0x20 || ch > 0x7E) ch = ' ';
    const uint8_t *g = FONT8X8[ch - 0x20];

    for (int row = 0; row < GLYPH_H; ++row) {
        uint8_t bits = g[row];
        for (int col = 0; col < GLYPH_W; ++col) {
            if (!((bits >> col) & 0x01)) continue;
            for (int dy = 0; dy < scale; ++dy) {
                int yy = y0 + row * scale + dy;
                if (yy < 0 || yy >= canvas_h) continue;
                uint16_t *line = canvas + (size_t)yy * canvas_w;
                for (int dx = 0; dx < scale; ++dx) {
                    int xx = x0 + col * scale + dx;
                    if (xx < 0 || xx >= canvas_w) continue;
                    line[xx] = color_be;
                }
            }
        }
    }
}

static void draw_text_centered(uint16_t *canvas, const char *s, int y0, int scale, uint16_t color_be)
{
    int len = (int)strlen(s);
    int w   = len * GLYPH_W * scale;
    int x0  = (SCR_W - w) / 2;
    if (x0 < 0) x0 = 0;   // left-align (and clip) if wider than the screen
    for (int i = 0; i < len; ++i) {
        draw_glyph(canvas, SCR_W, SCR_H, x0 + i * GLYPH_W * scale, y0, s[i], scale, color_be);
    }
}

// ── Shared primitives (declared in status_screen.h) ──────────────────────────

uint16_t status_be565(uint16_t color) { return be565(color); }

int status_text_width(const char *s, int scale) { return (int)strlen(s) * GLYPH_W * scale; }

void status_draw_text(uint16_t *canvas, int canvas_w, int canvas_h,
                      int x, int y, const char *s, int scale, uint16_t color_be)
{
    int len = (int)strlen(s);
    for (int i = 0; i < len; ++i) {
        draw_glyph(canvas, canvas_w, canvas_h, x + i * GLYPH_W * scale, y, s[i], scale, color_be);
    }
}

void status_blit(const uint16_t *canvas, int w, int h, int dst_x, int dst_y)
{
    if (!s_panel) return;
    uint16_t *strip = (uint16_t *)heap_caps_malloc((size_t)w * STRIP_H * 2, MALLOC_CAP_DMA);
    if (!strip) {
        ESP_LOGE(TAG, "blit strip alloc failed");
        return;
    }
    // Take the DMA-done semaphore BEFORE refilling the shared strip so the
    // previous transfer has finished reading it.
    for (int sy = 0; sy < h; sy += STRIP_H) {
        int rows = (sy + STRIP_H <= h) ? STRIP_H : (h - sy);
        if (s_dma_sem) xSemaphoreTake(s_dma_sem, pdMS_TO_TICKS(200));
        memcpy(strip, canvas + (size_t)sy * w, (size_t)rows * w * 2);
        esp_lcd_panel_draw_bitmap(s_panel, dst_x, dst_y + sy, dst_x + w, dst_y + sy + rows, strip);
    }
    // Wait for the final transfer before freeing `strip`, then restore the
    // semaphore to "available" for the next drawer.
    if (s_dma_sem) {
        xSemaphoreTake(s_dma_sem, pdMS_TO_TICKS(200));
        xSemaphoreGive(s_dma_sem);
    }
    heap_caps_free(strip);
}

void status_screen_init(esp_lcd_panel_handle_t panel, SemaphoreHandle_t dma_done_sem)
{
    s_panel   = panel;
    s_dma_sem = dma_done_sem;
}

void status_screen_show(const char *l1, const char *l2, const char *l3, const char *l4)
{
    if (!s_panel) return;

    // Full-screen canvas (CPU-rendered) in PSRAM; staging strip in internal
    // DMA-capable RAM. A full RGB565 frame is ~434 KB — too big for internal RAM.
    uint16_t *canvas = (uint16_t *)heap_caps_malloc((size_t)SCR_W * SCR_H * 2, MALLOC_CAP_SPIRAM);
    if (!canvas) {
        ESP_LOGE(TAG, "canvas alloc failed");
        return;
    }

    // Background fill.
    uint16_t bg = be565(COL_BG);
    for (size_t i = 0; i < (size_t)SCR_W * SCR_H; ++i) canvas[i] = bg;

    // Render the lines as a vertically-centred block.
    const char *lines[4]    = { l1, l2, l3, l4 };
    const int   scales[4]   = { TITLE_SCALE, BODY_SCALE, BODY_SCALE, BODY_SCALE };
    const uint16_t colors[4] = { be565(COL_TITLE), be565(COL_STATUS),
                                 be565(COL_INFO),  be565(COL_INFO) };

    int total_h = 0, count = 0;
    for (int i = 0; i < 4; ++i) {
        if (!lines[i]) continue;
        total_h += GLYPH_H * scales[i];
        count++;
    }
    if (count > 1) total_h += (count - 1) * LINE_GAP;

    int y = (SCR_H - total_h) / 2;
    if (y < 0) y = 0;
    for (int i = 0; i < 4; ++i) {
        if (!lines[i]) continue;
        draw_text_centered(canvas, lines[i], y, scales[i], colors[i]);
        y += GLYPH_H * scales[i] + LINE_GAP;
    }

    // Blit the whole canvas (handles strip staging + DMA-done sync).
    status_blit(canvas, SCR_W, SCR_H, 0, 0);

    heap_caps_free(canvas);
}
